## boards/shields/skeletyl/Kconfig.shield
```kconfig
# No whitespace after the comma or in your part name!
config SHIELD_SKELETYL
    def_bool $(shields_list_contains,skeletyl_left)

# No whitespace after the comma or in your part name!
config SHIELD_MY_KEYBOARD_RIGHT
    def_bool $(shields_list_contains,skeletyl_right)
```
