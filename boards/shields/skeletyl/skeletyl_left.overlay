#include "skeletyl.dtsi"

&kscan0 {
    col-gpios
		= <&xiao_d  8 (GPIO_ACTIVE_HIGH | GPIO_PULL_DOWN)>
		, <&xiao_d  0 (GPIO_ACTIVE_HIGH | GPIO_PULL_DOWN)>
		, <&xiao_d  3 (GPIO_ACTIVE_HIGH | GPIO_PULL_DOWN)>
		, <&xiao_d  4 (GPIO_ACTIVE_HIGH | GPIO_PULL_DOWN)>
		, <&xiao_d  5 (GPIO_ACTIVE_HIGH | GPIO_PULL_DOWN)>
		;
};